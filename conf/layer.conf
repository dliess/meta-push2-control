## conf/layer.conf
```bitbake
# We have a conf and classes directory, add to BBPATH
BBPATH .= ":${LAYERDIR}"

# We have recipes-* directories, add to BBFILES
BBFILES += "${LAYERDIR}/recipes-*/*/*.bb ${LAYERDIR}/recipes-*/*/*.bbappend ${LAYERDIR}/images/*.bb"

BBFILE_COLLECTIONS += "push2-control"

BBFILE_PATTERN_push2-control = "^${LAYERDIR}/"
BBFILE_PRIORITY_push2-control = "1"
LAYERSERIES_COMPAT_push2-control = "zeus"
```
